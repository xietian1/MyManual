## openWRT-kernel-module-developement/mydrv/src/Kconfig
```kconfig
config MYDRV
        tristate "test mydrv"
        help
        This is a example, for debugging kernel model.
        If unsure, say N.
```
